## main/Kconfig.projbuild
```kconfig
menu "Temperature Probe (MAX31865 + WiFi/MQTT)"

    menu "WiFi"
        config TP_WIFI_SSID
            string "WiFi SSID"
            default "myssid"
            help
                SSID (network name) of the 2.4 GHz WiFi network to join.
        config TP_WIFI_PASSWORD
            string "WiFi password"
            default "mypassword"
            help
                WPA/WPA2 passphrase. Leave empty for an open network.
        config TP_WIFI_MAX_RETRY
            int "Max immediate reconnect retries before backing off"
            default 8
    endmenu

    menu "MQTT"
        config TP_MQTT_URI
            string "Broker URI"
            default "mqtt://192.168.10.200:1883"
            help
                Full broker URI, e.g. mqtt://host:1883 or mqtts://host:8883.
        config TP_MQTT_USER
            string "Username"
            default "tasmota"
        config TP_MQTT_PASSWORD
            string "Password"
            default ""
        config TP_MQTT_TOPIC_PREFIX
            string "MQTT topic prefix for state/command topics"
            default "mechination"
            help
                Leading namespace for this device's state/command topics
                (<prefix>/<device_id>/...). Only the Home Assistant discovery
                config messages use TP_HA_DISCOVERY_PREFIX ("homeassistant").
        config TP_DEVICE_ID
            string "Device ID (blank = auto-derive from MAC)"
            default ""
            help
                Stable unique identifier placed in the topic path
                (<prefix>/<device_id>/...) and used for the Home Assistant
                unique_id, discovery object path and device identifier. Leave
                blank to auto-derive as tempprobe_<mac3> (unique per board). Set
                an explicit slug (e.g. mash_tun, boil_kettle) to run several
                probes side by side without collisions.
        config TP_HA_DISCOVERY_PREFIX
            string "Home Assistant discovery prefix"
            default "homeassistant"
        config TP_DEVICE_NAME
            string "Device name (shown in Home Assistant)"
            default "Brewery Temp Probe"
    endmenu

    menu "SPI / wiring (XIAO ESP32-C6)"
        config TP_SPI_SCLK_GPIO
            int "SCLK GPIO (D8)"
            default 19
        config TP_SPI_MISO_GPIO
            int "MISO GPIO (D9)"
            default 20
        config TP_SPI_MOSI_GPIO
            int "MOSI GPIO (D10)"
            default 18
        config TP_SPI_CS_GPIO
            int "MAX31865 CS GPIO (D5)"
            default 23
        config TP_DRDY_GPIO
            int "MAX31865 DRDY GPIO (D4, active LOW)"
            default 22
            help
                Data-ready signal from the MAX31865. In continuous conversion
                mode it pulses LOW when a new conversion is available; used for
                interrupt-driven oversampling. Set to -1 to disable.
        config TP_SPI_CLOCK_HZ
            int "SPI clock (Hz)"
            default 1000000
            help
                MAX31865 supports up to 5 MHz. 1 MHz is conservative and reliable
                on long breakout jumpers.
    endmenu

    menu "External antenna (XIAO ESP32-C6 RF switch)"
        config TP_USE_EXTERNAL_ANTENNA
            bool "Use the external (U.FL) antenna"
            default y
            help
                The XIAO ESP32-C6 has an on-board RF switch. GPIO3 must be driven
                LOW to power the switch, then GPIO14 selects the antenna
                (LOW = on-board ceramic, HIGH = external U.FL). This is the
                power-on default; it is also writable over MQTT and persisted.
        config TP_ANT_RF_SWITCH_EN_GPIO
            int "RF switch power-enable GPIO (active LOW)"
            default 3
        config TP_ANT_SELECT_GPIO
            int "Antenna select GPIO (HIGH = external)"
            default 14
    endmenu

    menu "Factory-reset button"
        config TP_FACTORY_RESET_GPIO
            int "Factory-reset button GPIO (active LOW)"
            default 9
            help
                Active-LOW pushbutton. Holding it for TP_FACTORY_RESET_HOLD_MS
                erases the persisted runtime config (antenna, alpha) and reboots.
                Default 9 is the XIAO ESP32-C6 on-board BOOT button.
        config TP_FACTORY_RESET_HOLD_MS
            int "Hold time to trigger factory reset (ms)"
            default 3000
    endmenu

    menu "RTD / sensor"
        choice TP_RTD_TYPE
            prompt "RTD type"
            default TP_RTD_PT100
            config TP_RTD_PT100
                bool "PT100 (100 ohm)"
            config TP_RTD_PT1000
                bool "PT1000 (1000 ohm)"
        endchoice

        config TP_RTD_NOMINAL_OHMS
            int "RTD nominal resistance at 0 C (ohms)"
            default 100 if TP_RTD_PT100
            default 1000 if TP_RTD_PT1000

        config TP_RTD_REF_OHMS
            int "Reference resistor Rref (ohms)"
            default 430 if TP_RTD_PT100
            default 4300 if TP_RTD_PT1000
            help
                Adafruit PT100 breakout = 430 ohm, PT1000 breakout = 4300 ohm.

        choice TP_RTD_WIRES
            prompt "RTD wiring"
            default TP_RTD_3WIRE
            config TP_RTD_2WIRE
                bool "2-wire"
            config TP_RTD_3WIRE
                bool "3-wire"
            config TP_RTD_4WIRE
                bool "4-wire"
        endchoice

        config TP_RTD_FILTER_50HZ
            bool "50 Hz mains filter (disable for 60 Hz regions)"
            default y
            help
                Enable for 50 Hz mains (Australia/EU), disable for 60 Hz.
    endmenu

    menu "Sampling & reporting"
        config TP_SAMPLE_PERIOD_MS
            int "MQTT publish period (ms)"
            default 1000
            range 50 60000
            help
                How often the firmware publishes the current (EMA-smoothed)
                reading to MQTT. The exponential filter runs on every MAX31865
                conversion (DRDY-driven, ~50/s); this is only the publish cadence.
                Keep <= 1000 to report at least once per second.

        config TP_EMA_ALPHA_PERMILLE
            int "EMA smoothing alpha (x1000)"
            default 400
            range 1 1000
            help
                Exponential moving-average weight applied to each conversion:
                y += alpha*(x - y). Stored as alpha x 1000, so 400 = 0.40.
                Lower = smoother but laggier; 1000 = no smoothing (raw). This is
                the power-on default; it is writable over MQTT (a Home Assistant
                number entity) and the runtime value is persisted to NVS.
    endmenu

endmenu
```
